## conf/machine/cl-imx93.conf
```bitbake
require conf/machine/include/imx-base.inc
require conf/machine/include/arm/armv8-2a/tune-cortexa55.inc
require compulab-imx9.inc

# One production image for UCM-i.MX93 and MCM-i.MX93. U-Boot selects the
# matching Linux device tree from the module EEPROM at runtime.
MACHINE_FEATURES += "pci wifi bluetooth"
MACHINE_FEATURES:append:use-nxp-bsp = " optee jailhouse "

KERNEL_DEVICETREE_BASENAME = "ucm-imx93"
KERNEL_DEVICETREE = " \
    compulab/ucm-imx93.dtb \
    compulab/ucm-imx93-mipi.dtb \
    compulab/ucm-imx93-headless.dtb \
    compulab/ucm-imx93-mipi-csi.dtb \
    compulab/ucm-imx93-eb-eth.dtb \
    compulab/ucm-imx93-ml.dtb \
    compulab/sbc-mcm-imx93.dtb \
    compulab/sbc-mcm-imx93-ml.dtb \
    compulab/sbc-mcm-imx93-mipi-csi.dtb \
"

UBOOT_DEVICETREE_BASENAME = "cl-imx93"
UBOOT_DTB_NAME = "${UBOOT_DEVICETREE_BASENAME}.dtb"

IMX_DEFAULT_BOOTLOADER:use-nxp-bsp = "u-boot-compulab"
IMX_DEFAULT_BOOTLOADER:use-mainline-bsp = "u-boot-compulab"

LOADADDR = ""
UBOOT_SUFFIX = "bin"
UBOOT_MAKE_TARGET = ""

SPL_BINARY = "spl/u-boot-spl.bin"

UBOOT_CONFIG_BASENAME = "cl-imx93"
EXTRA_OEMAKE:append:pn-u-boot-compulab = " DEVICE_TREE=${UBOOT_DEVICETREE_BASENAME} ENV_SOURCE_FILE=imx93"

UBOOT_CONFIG ??= "sd"
UBOOT_CONFIG[sd] = "${UBOOT_CONFIG_BASENAME}_defconfig"
UBOOT_CONFIG_IMAGE_FSTYPES[sd] = "sdcard"

ATF_PLATFORM = "imx93"

IMXBOOT_TARGETS = "flash_singleboot"
IMX_BOOT_SOC_TARGET = "iMX9"
IMX_BOOT_SEEK = "32"

SERIAL_CONSOLES = "115200;ttyLP0"

MACHINE_FIRMWARE:append = " ethos-u-firmware linux-firmware-sd8997 "

DDR_FIRMWARE_NAME = " \
    lpddr4_dmem_1d_v202201.bin \
    lpddr4_dmem_2d_v202201.bin \
    lpddr4_imem_1d_v202201.bin \
    lpddr4_imem_2d_v202201.bin \
"

SECO_FIRMWARE_NAME:mx9-nxp-bsp = "mx93a0-ahab-container.img"

IMAGE_BOOT_FILES:append:use-nxp-bsp = " \
    imx93_m33_TCM_rpmsg_lite_pingpong_rtos_linux_remote.bin \
    imx93_m33_TCM_rpmsg_lite_str_echo_rtos.bin \
"
WKS_FILE_DEPENDS:append = " imx-m33-demos"

CL_RELEASE = "3.1"
```

## conf/machine/compulab-imx9.inc
```bitbake
MACHINEOVERRIDES =. "mx93:compulab-mx93:"

PREFERRED_PROVIDER_virtual/kernel:compulab-mx93 = "linux-compulab"
PREFERRED_PROVIDER_virtual/bootloader:compulab-mx93 = "u-boot-compulab"
PREFERRED_PROVIDER_linux-imx-mfgtool:compulab-mx93 = "linux-compulab-mfgtool"
PREFERRED_PROVIDER_linux-compulab-mfgtool:compulab-mx93 = "linux-compulab-mfgtool"

CORE_IMAGE_EXTRA_INSTALL:append = " kernel-image kernel-modules \
    kernel-devicetree \
    kernel-module-nxp-wlan \
    firmware-nxp-wifi-nxp-common \
"

IMAGE_INSTALL:append = " python3-pytest "
IMAGE_INSTALL:append = " e2fsprogs-tune2fs openssh openssh-sshd "
IMAGE_INSTALL:append = " docker "
IMAGE_INSTALL:append = " nfs-utils "

PREFERRED_RROVIDER_u-boot-fw-utils = "libubootenv-bin"

CORE_IMAGE_EXTRA_INSTALL:append = " \
    ethos-u-firmware \
    linux-firmware-sd8997 \
    linux-firmware-iwlwifi-cc-a0 \
    linux-firmware-iwlwifi-ty-a0 \
    linux-firmware-ibt-20 \
    linux-firmware-ibt-41-41 \
"
```

## conf/machine/compulab-imx91.inc
```bitbake
MACHINEOVERRIDES =. "mx91:compulab-mx91:"

PREFERRED_PROVIDER_virtual/kernel:compulab-mx91 = "linux-compulab"
PREFERRED_PROVIDER_virtual/bootloader:compulab-mx91 = "u-boot-compulab"
PREFERRED_PROVIDER_linux-imx-mfgtool:compulab-mx91 = "linux-compulab-mfgtool"
PREFERRED_PROVIDER_linux-compulab-mfgtool:compulab-mx91 = "linux-compulab-mfgtool"

IMAGE_INSTALL:append = " \
	kernel-image \
	kernel-modules \
	kernel-devicetree \
"

PREFERRED_RROVIDER_u-boot-fw-utils = "libubootenv-bin"
```

## conf/machine/iot-link.conf
```bitbake
require conf/machine/include/imx-base.inc
require conf/machine/include/arm/armv8-2a/tune-cortexa55.inc
require compulab-imx9.inc

IMAGE_INSTALL:append = " firmware-nxp-wifi-nxpiw612-sdio "
IMAGE_INSTALL:append = " wwan-config "
IMAGE_INSTALL:append = " wlan-config "
IMAGE_INSTALL:append = " can-config "
IMAGE_INSTALL:append = " evtest "
IMAGE_INSTALL:append = " tpm2-tools libtss2-tcti-device "

MACHINE_FEATURES += "wifi bluetooth"
MACHINE_FEATURES:append:use-nxp-bsp = " optee jailhouse "
MACHINE_FEATURES:append = "nxpiw612-sdio"

KERNEL_CLASSES += "kernel-fitimage"
KERNEL_IMAGETYPES:append = " fitImage "

# components to include
KERNEL_DEVICETREE_BASENAME = "iot-link"
DTB="${KERNEL_DEVICETREE_BASENAME}.dtb"
KERNEL_DEVICETREE = " \
    compulab/${DTB} \
    compulab/iot-link-fars485.dtbo \
    compulab/iot-link-fbrs485.dtbo \
    compulab/iot-link-facan.dtbo \
    compulab/iot-link-fbcan.dtbo \
"
UBOOT_DTB_NAME:iot-link = "${DTB}"
FIT_CONF_DEFAULT_DTB = "${DTB}"
FIT_DESC ?= "fitImage for C-Lab ${MACHINE} BSP Release ${CL_RELEASE}, Kernel ${PV}"

# Required RAM addresses for ARM64 FIT Image assembly
UBOOT_ENTRYPOINT      = "0x80480000"
UBOOT_LOADADDRESS     = "0x80480000"
# Push the FIT image internal FDT destination away from the kernel
UBOOT_DTB_LOADADDRESS = "0x93000000"
UBOOT_DTBO_LOADADDRESS = "0x93100000"

FIT_GENERATE_KEYS = "1"

IMX_DEFAULT_BOOTLOADER:use-nxp-bsp = "u-boot-compulab"
IMX_DEFAULT_BOOTLOADER:use-mainline-bsp = "u-boot-compulab"

LOADADDR = ""
UBOOT_SUFFIX = "bin"
UBOOT_MAKE_TARGET = ""

SPL_BINARY = "spl/u-boot-spl.bin"

UBOOT_CONFIG_BASENAME = "iot-link"

UBOOT_CONFIG ??= "sd"
UBOOT_CONFIG[sd]   = "${UBOOT_CONFIG_BASENAME}_defconfig,sdcard"
UBOOT_CONFIG[ecc]  = "${UBOOT_CONFIG_BASENAME}_inline_ecc_defconfig"
UBOOT_CONFIG[ld]   = "${UBOOT_CONFIG_BASENAME}_ld_defconfig"

# Set ATF platform name
ATF_PLATFORM = "imx93"

IMXBOOT_TARGETS = "flash_singleboot"

IMX_BOOT_SOC_TARGET = "iMX9"
IMX_BOOT_SEEK = "32"

# We have to disable SERIAL_CONSOLE due to auto-serial-console
SERIAL_CONSOLES = "115200;ttyLP0"

# Add additional firmware
MACHINE_FIRMWARE:append = " ethos-u-firmware linux-firmware-sd8997 "

DDR_FIRMWARE_NAME = " \
        lpddr4_dmem_1d_v202201.bin \
        lpddr4_dmem_2d_v202201.bin \
        lpddr4_imem_1d_v202201.bin \
        lpddr4_imem_2d_v202201.bin \
"

IMAGE_BOOT_FILES:append:use-nxp-bsp = " \
        imx93_m33_TCM_rpmsg_lite_pingpong_rtos_linux_remote.bin \
        imx93_m33_TCM_rpmsg_lite_str_echo_rtos.bin \
"
WKS_FILE_DEPENDS:append = " imx-m33-demos"

CL_RELEASE = "1.0"
```

## conf/machine/ucm-imx91.conf
```bitbake
require conf/machine/include/imx-base.inc
require conf/machine/include/arm/armv8-2a/tune-cortexa55.inc
require compulab-imx91.inc

MACHINE_FEATURES += "pci wifi bluetooth"
MACHINE_FEATURES:append:use-nxp-bsp = " optee jailhouse "

KERNEL_DEVICETREE_BASENAME = "ucm-imx91"
KERNEL_DEVICETREE = " \
    compulab/${KERNEL_DEVICETREE_BASENAME}.dtb \
"
UBOOT_DTB_NAME = "${KERNEL_DEVICETREE_BASENAME}.dtb"

IMX_DEFAULT_BOOTLOADER:use-nxp-bsp = "u-boot-compulab"
IMX_DEFAULT_BOOTLOADER:use-mainline-bsp = "u-boot-compulab"

LOADADDR = ""
UBOOT_SUFFIX = "bin"
UBOOT_MAKE_TARGET = ""

SPL_BINARY = "spl/u-boot-spl.bin"

UBOOT_CONFIG_BASENAME = "ucm-imx91"

UBOOT_CONFIG ??= "sd"
UBOOT_CONFIG[sd] = "${UBOOT_CONFIG_BASENAME}_defconfig"
UBOOT_CONFIG_IMAGE_FSTYPES[sd] = "sdcard"

# Set ATF platform name
ATF_PLATFORM = "imx91"

IMXBOOT_TARGETS = "flash_singleboot"

IMX_BOOT_SOC_TARGET = "iMX91"
IMX_BOOT_SEEK = "32"

# We have to disable SERIAL_CONSOLE due to auto-serial-console
SERIAL_CONSOLES = "115200;ttyLP0"

# Add additional firmware
MACHINE_FIRMWARE:append = " linux-firmware-sd8997 "

DDR_FIRMWARE_NAME = " \
        lpddr4_dmem_1d_v202201.bin \
        lpddr4_dmem_2d_v202201.bin \
        lpddr4_imem_1d_v202201.bin \
        lpddr4_imem_2d_v202201.bin \
"

SECO_FIRMWARE_NAME:mx9-nxp-bsp = "mx91a0-ahab-container.img"

CL_RELEASE = "1.0"
```
