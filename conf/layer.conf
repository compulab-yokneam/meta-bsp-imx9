## conf/layer.conf
```bitbake
# We have a conf and classes directory, append to BBPATH
BBPATH .= ":${LAYERDIR}"

# We have a recipes directory containing .bb and .bbappend files, add to BBFILES
BBFILES += "${LAYERDIR}/recipes-*/*/*.bb \
            ${LAYERDIR}/recipes-*/*/*.bbappend"

BBFILE_COLLECTIONS += "compulab-bsp-imx9"
BBFILE_PATTERN_compulab-bsp-imx9 := "^${LAYERDIR}/"
BBFILE_PRIORITY_compulab-bsp-imx9 = "9"

CORE_IMAGE_EXTRA_INSTALL += " kernel-modules "

BBMASK += "meta-compulab/recipes-xfce"
BBMASK += "meta-compulab/recipes-kernel"
BBMASK += "meta-compulab/recipes-graphics"
BBMASK += ".*boundary.*"
BBMASK += "meta-compulab/recipes-bsp/u-boot/u-boot-fw-utils_%.bbappend"
# To be removed from the layer
BBMASK += "meta-multimedia/recipes-nnstreamer/nnshark/nnshark_%.bbappend"
BBMASK += "u-boot-compulab_2020.04.bbappend"
# The layer recipe will be used
BBMASK += " meta/recipes-kernel/perf/perf.bb "
# Fix build warnings
BBMASK += " bt-start_1.0.bb "
BBMASK += " u-boot-update-script.bb "

# Mask connman in order to allow installing Network/Modem Managers
# The layer provided package is a stub that contains nothing.
BBMASK += " poky/meta/recipes-connectivity/connman "
PREFERRED_VERSION_connman = "9.99"

HOSTTOOLS += " git-lfs "
HOSTTOOLS += " bison "
HOSTTOOLS += " uudecode "
HOSTTOOLS += " rsync "

LAYERSERIES_COMPAT_compulab-bsp-imx9 = "kirkstone langdale"
```
